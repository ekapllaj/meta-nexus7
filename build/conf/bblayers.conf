## build/conf/bblayers.conf
```bitbake
# POKY_BBLAYERS_CONF_VERSION is increased each time build/conf/bblayers.conf
# changes incompatibly
POKY_BBLAYERS_CONF_VERSION = "2"

BBPATH = "${TOPDIR}"
BBFILES ?= ""

BBLAYERS ?= " \
  /home/asus/work/yocto-nexus7/sources/poky/meta \
  /home/asus/work/yocto-nexus7/sources/poky/meta-poky \
  /home/asus/work/yocto-nexus7/sources/poky/meta-yocto-bsp \
  /home/asus/work/yocto-nexus7/sources/meta-openembedded/meta-oe \
  /home/asus/work/yocto-nexus7/sources/meta-openembedded/meta-networking \
  /home/asus/work/yocto-nexus7/sources/meta-openembedded/meta-python \
  /home/asus/work/yocto-nexus7/sources/meta-nexus7 \
  "
```

## conf/layer.conf
```bitbake
# We have a conf and classes directory, append to BBPATH
BBPATH .= ":${LAYERDIR}"

# We have recipes-* directories, add to BBFILES
BBFILES += "\
	${LAYERDIR}/recipes-*/*/*.bb \
	${LAYERDIR}/recipes-*/*/*.bbappend\
"

BBFILE_COLLECTIONS += "nexus7"
BBFILE_PATTERN_nexus7 = "^${LAYERDIR}/"
BBFILE_PRIORITY_nexus7 = "9"

LAYERDEPENDS_elvis = "core"
```

## conf/machine/nexus7.conf
```bitbake
#@TYPE: Machine
#@NAME: nexus7 2012
#@DESCRIPTION: ASUS nexus 7 2012 tablet
#@MAINTAINER: Elvis Kapllaj <kapllaj.elvis@gmail.com>
#

require conf/machine/include/soc-family.inc
SOC_FAMILY = "tegra:tegra3"

require conf/machine/include/tune-cortexa9.inc

# remove X11, just start supporting a small console only image so far.
DISTRO_FEATURES_remove ="alsa bluetooth nfs 3g wayland bluez5"
IMAGE_FSTYPES += "tar.gz"

DEFAULTTUNE = "cortexa9thf-neon"

PREFERRED_PROVIDER_virtual/kernel = "linux-nexus7"
PREFERRED_VERSION_xserver-xorg = "1.14%"
PREFERRED_PROVIDER_virtual/egl = "nv-drivers"
PREFERRED_PROVIDER_virtual/libgles1 = "nv-drivers"
PREFERRED_PROVIDER_virtual/libgles2 = "nv-drivers"

# This project starts with kernel 3.1.10, which has problems building with gcc > 5
GCCVERSION ?= "4%"
CORE_IMAGE_EXTRA_INSTALL_append = "kernel-modules"

DISTRO_FEATURES_append = " systemd"
DISTRO_FEATURES_BACKFILL_CONSIDERED += "sysvinit"
VIRTUAL-RUNTIME_init_manager = "systemd"
VIRTUAL-RUNTIME_initscripts = "systemd-compat-units"
```
